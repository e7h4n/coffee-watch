## firmware/demo/main/Kconfig.projbuild
```kconfig
menu "Coffee Watch"
    config CW_LAUNCHER_APP
        bool "Run as an esp-launcher app (remote logs/commands; updates installed by the launcher)"
        default n
        help
            Starts the EspHub SDK with the bootloader's saved Wi-Fi networks and supports
            remote logs and commands. Uses the EspHub app slot in partitions-launcher.csv.
endmenu
```
